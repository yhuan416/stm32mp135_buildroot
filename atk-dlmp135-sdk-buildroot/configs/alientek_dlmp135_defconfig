## atk-dlmp135-sdk-buildroot/configs/alientek_dlmp135_defconfig
```kconfig
# architecture
BR2_arm=y
BR2_cortex_a7=y

# toolchain
BR2_TOOLCHAIN_BUILDROOT_WCHAR=y
BR2_TOOLCHAIN_BUILDROOT_CXX=y
BR2_KERNEL_HEADERS_5_15=y
BR2_TOOLCHAIN_BUILDROOT_LOCALE=y
BR2_GCC_VERSION_9_X=y
BR2_TOOLCHAIN_BUILDROOT_GLIBC=y
#BR2_TOOLCHAIN_BUILDROOT_UCLIBC=y

# system
BR2_TARGET_GENERIC_GETTY_PORT="ttySTM0"

# AUDIO
BR2_PACKAGE_ALSA_UTILS=y
BR2_PACKAGE_ALSA_UTILS_ALSACONF=y
BR2_PACKAGE_ALSA_UTILS_AMIXER=y
BR2_PACKAGE_ALSA_UTILS_APLAY=y
BR2_PACKAGE_ALSA_PLUGINS=y
BR2_PACKAGE_LIBMAD=y
BR2_PACKAGE_ALSA_UTILS_ALSALOOP=y
# Copy alas configs
BR2_PACKAGE_ALSA_CONFIG=y

# PULSEAUDIO
BR2_PACKAGE_PULSEAUDIO=y

# required tools to create the SD card image
BR2_PACKAGE_HOST_DOSFSTOOLS=y
BR2_PACKAGE_HOST_GENIMAGE=y
BR2_PACKAGE_HOST_MTOOLS=y

# System configuration
BR2_TARGET_GENERIC_HOSTNAME="ATK-DLMP135"
BR2_TARGET_GENERIC_ISSUE="Welcome, the world is in your hands"
BR2_INIT_BUSYBOX=y

# filesystem / image
BR2_TARGET_ROOTFS_EXT2_SIZE="512M"
BR2_TARGET_ROOTFS_EXT2=y
BR2_TARGET_ROOTFS_EXT2_4=y
BR2_TARGET_GENERIC_ROOT_PASSWD="root"

# new settings
BR2_PACKAGE_MESA3D=y
BR2_PACKAGE_MESA3D_GALLIUM_DRIVER_LIMA=y
BR2_PACKAGE_MESA3D_OPENGL_EGL=y
BR2_PACKAGE_MESA3D_OPENGL_ES=y
BR2_PACKAGE_PROVIDES_LIBGLES="mesa3d"
BR2_TOOLCHAIN_USES_GLIBC=y
BR2_PACKAGE_QT5BASE_OPENGL=y
BR2_PACKAGE_QT5_GL_AVAILABLE=y

BR2_SKIP_LEGACY=y
# BLUEZ5
BR2_PACKAGE_BLUEZ_ALSA=y
BR2_PACKAGE_BLUEZ_ALSA_HCITOP=y
BR2_PACKAGE_BLUEZ5_UTILS=y
BR2_PACKAGE_BLUEZ5_UTILS_OBEX=y
BR2_PACKAGE_BLUEZ5_UTILS_CLIENT=y
BR2_PACKAGE_BLUEZ5_UTILS_GATTTOOL=y
BR2_PACKAGE_BLUEZ5_UTILS_EXPERIMENTAL=y
BR2_PACKAGE_BLUEZ5_UTILS_TOOLS=y
BR2_PACKAGE_BLUEZ5_UTILS_MONITOR=y
BR2_PACKAGE_BLUEZ5_UTILS_PLUGINS_HEALTH=y
BR2_PACKAGE_BLUEZ5_UTILS_PLUGINS_HID=y
BR2_PACKAGE_BLUEZ5_UTILS_PLUGINS_MESH=y
BR2_PACKAGE_BLUEZ5_UTILS_PLUGINS_MIDI=y
BR2_PACKAGE_BLUEZ5_UTILS_PLUGINS_NFC=y
BR2_PACKAGE_BLUEZ5_UTILS_PLUGINS_SAP=y
BR2_PACKAGE_BLUEZ5_UTILS_PLUGINS_SIXAXIS=y
BR2_PACKAGE_BLUEZ5_UTILS_TEST=y
BR2_PACKAGE_BLUEZ5_UTILS_TOOLS_HID2HCI=y


# gstreamer-1.0
BR2_PACKAGE_GSTREAMER1=y
BR2_PACKAGE_GST1_PLUGINS_GOOD=y
BR2_PACKAGE_GST1_PLUGINS_GOOD_PLUGIN_V4L2=y
BR2_PACKAGE_GST1_PLUGINS_GOOD_PLUGIN_V4L2_PROBE=y
BR2_PACKAGE_GST1_PLUGINS_BAD=y
BR2_PACKAGE_GST1_PLUGINS_BAD_PLUGIN_VIDEOPARSERS=y
BR2_PACKAGE_GST1_PLUGINS_BAD_PLUGIN_KMS=y
BR2_PACKAGE_GST1_PLUGINS_BASE_INSTALL_TOOLS=y
BR2_PACKAGE_GST1_LIBAV=y

BR2_PACKAGE_GST1_PLUGINS_BASE_PLUGIN_ALSA=y
BR2_PACKAGE_GST1_PLUGINS_BASE_PLUGIN_VIDEOCONVERT=y
BR2_PACKAGE_GST1_PLUGINS_BASE_PLUGIN_VIDEOTESTSRC=y
BR2_PACKAGE_GST1_PLUGINS_GOOD_PLUGIN_AUDIOPARSERS=y
BR2_PACKAGE_GST1_PLUGINS_GOOD_PLUGIN_AUTODETECT=y
BR2_PACKAGE_GST1_PLUGINS_GOOD_PLUGIN_DEINTERLACE=y
BR2_PACKAGE_GST1_PLUGINS_GOOD_PLUGIN_FLV=y
BR2_PACKAGE_GST1_PLUGINS_GOOD_PLUGIN_GDKPIXBUF=y
BR2_PACKAGE_GST1_PLUGINS_GOOD_PLUGIN_MATROSKA=y
BR2_PACKAGE_GST1_PLUGINS_BAD_PLUGIN_DVBSUBOVERLAY=y
BR2_PACKAGE_GST1_PLUGINS_BAD_PLUGIN_DVDSPU=y
BR2_PACKAGE_GST1_PLUGINS_BAD_PLUGIN_JPEGFORMAT=y
BR2_PACKAGE_GST1_PLUGINS_BAD_PLUGIN_MPEGDEMUX=y
BR2_PACKAGE_GST1_PLUGINS_BAD_PLUGIN_MPEG2ENC=y
BR2_PACKAGE_GST1_PLUGINS_UGLY=y
BR2_PACKAGE_GST1_PLUGINS_UGLY_PLUGIN_ASFDEMUX=y
BR2_PACKAGE_GST1_PLUGINS_UGLY_PLUGIN_DVDLPCMDEC=y
BR2_PACKAGE_GST1_PLUGINS_UGLY_PLUGIN_DVDSUB=y
BR2_PACKAGE_GST1_PLUGINS_UGLY_PLUGIN_MPEG2DEC=y
# Support ADPCM format audio with gstreamer
BR2_PACKAGE_GST1_PLUGINS_BAD_PLUGIN_ADPCMDEC=y
BR2_PACKAGE_GST1_PLUGINS_BAD_PLUGIN_ADPCMENC=y
BR2_PACKAGE_GST1_PLUGINS_BAD_PLUGIN_FAAD=y
BR2_PACKAGE_GST1_PLUGINS_GOOD_PLUGIN_MPG123=y
# Elements used to communicate with camera applications
BR2_PACKAGE_GST1_PLUGINS_BASE_PLUGIN_APP=y
# Convert audio to different formats
BR2_PACKAGE_GST1_PLUGINS_BASE_PLUGIN_AUDIORATE=y
# Creates audio test signals of given frequency and volume
BR2_PACKAGE_GST1_PLUGINS_BASE_PLUGIN_AUDIOTESTSRC=y
# various encoding-related elements
BR2_PACKAGE_GST1_PLUGINS_BASE_PLUGIN_ENCODING=y
# Adjusts video frames
BR2_PACKAGE_GST1_PLUGINS_BASE_PLUGIN_VIDEORATE=y
# ogg stream manipulation (info about ogg: http://xiph.org)
BR2_PACKAGE_GST1_PLUGINS_BASE_PLUGIN_OGG=y
# Theora plugin library
BR2_PACKAGE_GST1_PLUGINS_BASE_PLUGIN_THEORA=y
# Vorbis plugin library
BR2_PACKAGE_GST1_PLUGINS_BASE_PLUGIN_VORBIS=y
# JPeg plugin library
BR2_PACKAGE_GST1_PLUGINS_GOOD_JPEG=y
# PNG plugin library
BR2_PACKAGE_GST1_PLUGINS_GOOD_PNG=y
# adds an alpha channel to video - constant or via chroma-keyin
BR2_PACKAGE_GST1_PLUGINS_GOOD_PLUGIN_ALPHA=y
# APEv1/2 tag reader
BR2_PACKAGE_GST1_PLUGINS_GOOD_PLUGIN_APETAG=y
# parses au streams
BR2_PACKAGE_GST1_PLUGINS_GOOD_PLUGIN_AUPARSE=y
# Demux ID3v1 and ID3v2 tags from a file
BR2_PACKAGE_GST1_PLUGINS_GOOD_PLUGIN_ID3DEMUX=y
# Reads/Writes buffers from/to sequentially named files
BR2_PACKAGE_GST1_PLUGINS_GOOD_PLUGIN_MULTIFILE=y
# Real-time protocol plugins
BR2_PACKAGE_GST1_PLUGINS_GOOD_PLUGIN_RTP=y
# RTP session management plugin librar
BR2_PACKAGE_GST1_PLUGINS_GOOD_PLUGIN_RTPMANAGER=y
# transfer data via RTSP
BR2_PACKAGE_GST1_PLUGINS_GOOD_PLUGIN_RTSP=y
# resizes a video by adding borders or cropping
BR2_PACKAGE_GST1_PLUGINS_GOOD_PLUGIN_VIDEOBOX=y
# Crops video into a user-defined region
BR2_PACKAGE_GST1_PLUGINS_GOOD_PLUGIN_VIDEOCROP=y
# Video filters plugin
BR2_PACKAGE_GST1_PLUGINS_GOOD_PLUGIN_VIDEOFILTER=y
# Video mixer
BR2_PACKAGE_GST1_PLUGINS_GOOD_PLUGIN_VIDEOMIXER=y
# Take image snapshots and record movies from camera
BR2_PACKAGE_GST1_PLUGINS_BAD_PLUGIN_CAMERABIN2=y
# MPEG TS demuxer
BR2_PACKAGE_GST1_PLUGINS_BAD_PLUGIN_MPEGTSDEMUX=y
# MPEG TS muxer
BR2_PACKAGE_GST1_PLUGINS_BAD_PLUGIN_MPEGTSMUX=y
# MPEG-PS muxer
BR2_PACKAGE_GST1_PLUGINS_BAD_PLUGIN_MPEGPSMUX=y

BR2_PACKAGE_GST1_PLUGINS_GOOD_PLUGIN_PULSE=y

# base_extra.config 
# For automatic kernel module loading
BR2_ROOTFS_DEVICE_CREATION_DYNAMIC_EUDEV=y
#  - vensor storage tool is used to r/w SN, wifi/bt/lan mac
BR2_PACKAGE_VENDOR_STORAGE=y
#  - usb device package used to init and config udc like adb and usb mass storage
BR2_PACKAGE_USBDEVICE=y
#  - usbmount used to mount usb disk to /media/ when it plug in
BR2_PACKAGE_USBMOUNT=y
#  - input event daemon used to handle key event, ie. power on/off system
BR2_PACKAGE_INPUT_EVENT_DAEMON=y
#  - upower used to monitor the power state of system
BR2_PACKAGE_UPOWER=y
#  - pm utils used to suspend/resume system
BR2_PACKAGE_PM_UTILS=y

# network.config
#  - user space IEEE 802.1X/WPA supplicant
BR2_PACKAGE_WPA_SUPPLICANT=y
#  - support ap mode for your wifi
BR2_PACKAGE_WPA_SUPPLICANT_AP_SUPPORT=y
#  - enable support for the autoscan feature (allow periodic scan)
#BR2_PACKAGE_WPA_SUPPLICANT_AUTOSCAN=y
#  - enable eap support for your wifi
BR2_PACKAGE_WPA_SUPPLICANT_EAP=y
#  - install wpa_cli command line utility
BR2_PACKAGE_WPA_SUPPLICANT_CLI=y
#  - install libwpa_client.so
BR2_PACKAGE_WPA_SUPPLICANT_WPA_CLIENT_SO=y
#  - install wpa_passphrase command line utility
BR2_PACKAGE_WPA_SUPPLICANT_PASSPHRASE=y
#  - a DHCP client
BR2_PACKAGE_DHCPCD=y
#  - a lightweight DNS and DHCP server. It is intended to provide coupled DNS and DHCP service to a LAN
BR2_PACKAGE_DNSMASQ=y
#  - a user space daemon for wireless access points.
BR2_PACKAGE_HOSTAPD=y
#  - Network Time Protocol, provides things like ntpd, ntpdate, ntpq, etc...
BR2_PACKAGE_NTP=y
#  - tiny ssh server and sftp server
BR2_PACKAGE_DROPBEAR=y
BR2_PACKAGE_GESFTPSERVER=y
BR2_PACKAGE_DROPBEAR_CLIENT=y

# benchmark
#  - unixbench can benchmark cpu, ram, disk etc
BR2_PACKAGE_UNIXBENCH=y
#  - iperf is a benchmark tool used to measure bandwidth on IP networks
BR2_PACKAGE_IPERF=y

# camera
# libv4l and its utils for v4l2 devices
BR2_PACKAGE_LIBV4L=y
BR2_PACKAGE_LIBV4L_UTILS=y
BR2_PACKAGE_CAMERA_ENGINE=y

# test
# test subset collect test tools 
#  - memtest used to testing the memory subsystem for faults
BR2_PACKAGE_MEMTESTER=y
#  - rt test is a set of utilities for testing the real-time behaviour of a Linux system
BR2_PACKAGE_RT_TESTS=y
#  - a configurable amount of CPU, memory, I/O, and disk stress on the system
BR2_PACKAGE_STRESS=y
#  - stress test on cpu and memory
BR2_PACKAGE_STRESSAPPTEST=y

# tar support
BR2_PACKAGE_BUSYBOX_SHOW_OTHERS=y
BR2_PACKAGE_TAR=y

# tslib
BR2_PACKAGE_TSLIB=y

# tar support
BR2_PACKAGE_BROTLI=y
BR2_PACKAGE_BZIP2=y
BR2_PACKAGE_LRZIP=y
BR2_PACKAGE_LZIP=y
BR2_PACKAGE_LZOP=y
BR2_PACKAGE_P7ZIP=y
BR2_PACKAGE_PIGZ=y
BR2_PACKAGE_PIXZ=y
BR2_PACKAGE_UNRAR=y
BR2_PACKAGE_XZ=y
BR2_PACKAGE_ZIP=y
BR2_PACKAGE_ZSTD=y

# Qt5
BR2_PACKAGE_QT5=y
BR2_PACKAGE_QT5_VERSION_5_12=y
BR2_PACKAGE_QT5BASE_WIDGETS=y
BR2_PACKAGE_QT5BASE_LICENSE_APPROVED=y
BR2_PACKAGE_QT5BASE_OPENGL_LIB=y
BR2_PACKAGE_QT5BASE_LINUXFB=y
BR2_PACKAGE_QT5BASE_GIF=y
BR2_PACKAGE_QT5BASE_JPEG=y
BR2_PACKAGE_QT5CINEX=y
BR2_PACKAGE_QT5CINEX_HD=y

BR2_PACKAGE_QT5CONNECTIVITY=y
BR2_PACKAGE_QT5TOOLS_LINGUIST_TOOLS=y
BR2_PACKAGE_QT5DECLARATIVE=y
BR2_PACKAGE_QT5MULTIMEDIA=y
BR2_PACKAGE_QT5QUICKCONTROLS=y
BR2_PACKAGE_QT5QUICKCONTROLS2=y
BR2_PACKAGE_QT5BASE_PNG=y
BR2_PACKAGE_QT5SVG=y
BR2_PACKAGE_QT5VIRTUALKEYBOARD=y
BR2_PACKAGE_QT5BASE_MYSQL=y
BR2_PACKAGE_QT5BASE_SQLITE_QT=y
BR2_PACKAGE_QT5BASE_DEFAULT_QPA="linuxfb"
BR2_PACKAGE_QT5BASE_LINUXFB_ARGB32=y
BR2_PACKAGE_QT5BASE_TSLIB=y
BR2_PACKAGE_QT5CHARTS=y
BR2_PACKAGE_QT5LOCATION=y
BR2_PACKAGE_QT5SERIALBUS=y
BR2_PACKAGE_QT5SERIALPORT=y
BR2_PACKAGE_QT5VIRTUALKEYBOARD_LANGUAGE_LAYOUTS="all"
BR2_PACKAGE_QT5VIRTUALKEYBOARD_HANDWRITING=y
BR2_PACKAGE_QT5WEBCHANNEL=y
BR2_PACKAGE_QT5WEBSOCKETS=y
BR2_PACKAGE_QJSON=y

# Chinese fonts
BR2_PACKAGE_SOURCE_HAN_SANS_CN=y

# other tools
BR2_PACKAGE_CONNMAN=y
BR2_PACKAGE_CONNMAN_WIFI=y
BR2_PACKAGE_CONNMAN_LOOPBACK=y
BR2_PACKAGE_CONNMAN_CLIENT=y
BR2_PACKAGE_PERL=y

BR2_PACKAGE_FILE=y
BR2_PACKAGE_UTIL_LINUX_RFKILL=y
BR2_PACKAGE_IPERF3=y
CONFIG_UDHCPD=y
BR2_TARGET_LOCALTIME="Asia/Shanghai"

BR2_PACKAGE_ATK_DLMP135=y
BR2_PACKAGE_ATK_DLMP135_SETTINGS=y
BR2_PACKAGE_QDESKTOP=y

BR2_PACKAGE_IPROUTE2=y
BR2_PACKAGE_IW=y
BR2_PACKAGE_RSYNC=y

BR2_PACKAGE_NETSTAT_NAT=y
BR2_PACKAGE_ETHTOOL=y
BR2_PACKAGE_PPPD=y
BR2_PACKAGE_EVTEST=y
BR2_PACKAGE_MINICOM=y
BR2_PACKAGE_COREUTILS=y
BR2_PACKAGE_COREUTILS_INDIVIDUAL_BINARIES=y

BR2_GENERATE_LOCALE="en_US"
BR2_SYSTEM_ENABLE_NLS=y
BR2_PACKAGE_MTD=y
BR2_PACKAGE_DOSFSTOOLS=y
BR2_PACKAGE_DOSFSTOOLS_MKFS_FAT=y
BR2_PACKAGE_DOSFSTOOLS_FATLABEL=y
BR2_PACKAGE_DOSFSTOOLS_FSCK_FAT=y
BR2_PACKAGE_CAN_UTILS=y
BR2_PACKAGE_MMC_UTILS=y

BR2_PACKAGE_GPTFDISK_SGDISK=y
BR2_PACKAGE_KMOD_TOOLS=y
BR2_PACKAGE_LIBDRM_INSTALL_TESTS=y
BR2_PACKAGE_BLUEZ_ALSA_RFCOMM=y
BR2_PACKAGE_GST1_PLUGINS_BAD_PLUGIN_BLUEZ=y
BR2_PACKAGE_GST1_PLUGINS_BAD_PLUGIN_FBDEV=y
BR2_TARGET_ROOTFS_EXT2_MKFS_OPTIONS="-O ^64bit -O ^metadata_csum"
```
